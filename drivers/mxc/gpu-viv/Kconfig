## drivers/mxc/gpu-viv/Kconfig
```kconfig
menu "MXC Vivante GPU support"
	depends on SOC_IMX6Q

config MXC_GPU_VIV
	tristate "MXC Vivante GPU support"
	---help---
         Say Y to get the GPU driver support.

config MXC_GPU_VIV_CMA_SIZE
	int "memory allocated for Vivante GPU"
	depends on MXC_GPU_VIV
	default 134217728

endmenu
```
